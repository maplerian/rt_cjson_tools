## Kconfig
```kconfig
# Kconfig file for package rt_cjson_tools
menuconfig PKG_USING_RT_CJSON_TOOLS
    bool "Please add description of rt_cjson_tools in English."
    default n

if PKG_USING_RT_CJSON_TOOLS

    config PKG_RT_CJSON_TOOLS_PATH
        string
        default "/packages/iot/rt_cjson_tools"

    choice
        prompt "Version"
        default PKG_USING_RT_CJSON_TOOLS_LATEST_VERSION
        help
            Select the package version

        config PKG_USING_RT_CJSON_TOOLS_V100
            bool "v1.0.0"

        config PKG_USING_RT_CJSON_TOOLS_LATEST_VERSION
            bool "latest"
    endchoice
          
    config PKG_RT_CJSON_TOOLS_VER
       string
       default "v1.0.0"    if PKG_USING_RT_CJSON_TOOLS_V100
       default "latest"    if PKG_USING_RT_CJSON_TOOLS_LATEST_VERSION

endif
```
